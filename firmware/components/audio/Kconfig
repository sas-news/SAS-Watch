## firmware/components/audio/Kconfig
```kconfig
menu "SAS-Watch audio"
    config WATCH_DISABLE_AUDIO
        bool "Disable audio (unit without speaker/codec)"
        default n
        help
            音声を丸ごと無効化する互換スイッチ。
            有効にすると PA/I2S/コーデック/音声タスクの初期化を
            すべてスキップし、beep/録音/再生は何もしなくなる。
            マイク/スピーカーの個別制御は下の ENABLE_* を使う。
    config WATCH_ENABLE_MIC
        bool "Enable microphone recording (ES7210)"
        default y
        help
            ES7210 マイク ADC + I2S RX による録音を有効化する。
            I2C でコーデックが見つからない機体では自動的に
            録音 UI を隠す。I2S/DMA は録音開始時にだけ確保する。
    config WATCH_ENABLE_SPEAKER
        bool "Enable speaker playback (ES8311 + PA)"
        default n
        help
            ES8311 コーデック + PA (GPIO46) による再生/ビープ。
            出音は未検証なので既定 off (録音だけ先行して有効化)。
endmenu
```

## firmware/components/ble_link/Kconfig.projbuild
```kconfig
menu "SAS-Watch"
    config SAS_BLE_LINK
        bool "BLE link (Phone 接続, docs/protocol-v1.md)"
        default y
        depends on BT_ENABLED && BT_NIMBLE_ENABLED
        help
            NimBLE GATT サーバ (ctrl/event/bulk)。app_main は
            #if CONFIG_SAS_BLE_LINK で ble_link_start() を呼ぶ。
endmenu
```

## firmware/components/ui/Kconfig
```kconfig
# ui コンポーネントの診断オプション。

config WATCH_DIAG_CORNERS
    bool "角曲率計測用オーバーレイを表示"
    default n
    help
        四隅に半径8px刻みの同心リングを重ねて表示し、
        パネル角の物理的な切れ込み半径を実機で計測するための
        診断オーバーレイ。リングが欠け始める位置が safe-area の目安。
        通常ファームでは n にする。
```
