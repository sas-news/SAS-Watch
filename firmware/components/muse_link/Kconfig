## firmware/components/muse_link/Kconfig
```kconfig
# Muse chat/Noise 層 (T50 Phase 1)
#
# 既定は無効。有効にすると firmware/components/muse_link の SDK コピーと
# アダプタがリンクされる (実測: flash +97,248B / 静的 DIRAM +5,776B / 静的 PSRAM +4,704B)。
# 実測は docs/muse-bmin.md。実接続は Phase 2 (M1 の資格情報が前提)。

menu "muse_link (Muse chat/Noise, Phase 1)"

    config WATCH_ENABLE_MUSE_LINK
        bool "Muse chat/Noise layer (foundation only)"
        default n
        help
            Meta の Muse Gadget SDK (pinned ec976f0, Apache-2.0) の chat/Noise 層を
            SAS-Watch に組み込む土台。Phase 1 は起動時に NVS (namespace "muse") の
            host/vm_id/token を読んで状態をログに出すだけ。ネットワーク接続・
            セッションタスク・大きな PSRAM 確保はせず、未設定なら no-op。

            Phase 2 でセッションタスク、音声アダプタ、UI 統合を足す。

    config WATCH_MUSE_MIN_INTERNAL_KB
        int "Muse start: minimum largest free internal block (KB)"
        depends on WATCH_ENABLE_MUSE_LINK
        range 0 64
        default 12
        help
            muse_link_start() の事前チェック。内蔵 SRAM の最大連続空きがこれ未満なら
            「内蔵メモリ不足で Muse を開始できません」で中止する。0 でチェック無効。
            TLS の内部 RAM 消費は実機未測定 (docs/muse-bmin.md §12 の GO/NO-GO)。

    config WATCH_MUSE_MIN_PSRAM_KB
        int "Muse start: minimum largest free PSRAM block (KB)"
        depends on WATCH_ENABLE_MUSE_LINK
        range 0 8192
        default 1400
        help
            muse_link_start() の事前チェック。SDK のセッションは PSRAM を約 1.3MB
            確保する。最大連続空きがこれ未満なら中止する。0 でチェック無効。

    config WATCH_MUSE_WIFI_IDLE_S
        int "Release Muse Wi-Fi after this many idle seconds"
        depends on WATCH_ENABLE_MUSE_LINK
        range 10 600
        default 60
        help
            Muse が自分で Wi-Fi を上げた (muse_link_wifi_ensure) 場合、最後の
            アクティビティからこの秒数で session_end する。他機能 (OTA 等) が
            上げている Wi-Fi は落とさない。0 は不可 (10〜600)。
            注意: 有効時のフラッシュ/PSRAM 増分は docs/muse-bmin.md 参照。

endmenu
```

## tools/muse-gadget/spike/components/muse_chat/Kconfig
```kconfig
# T49 spike: SDK components/muse/Kconfig のうち、chat 層が参照する設定だけを
# 最小限に写したもの。B-min で SAS-Watch に移植するときに必要な設定面の一覧でもある。
menu "Muse chat spike (T49)"

    config SPIKE_WITH_CHAT
        bool "T49 spike: compile the chat layer"
        default y
        help
            オフにすると noise_core だけでビルドする (S0)。サイズ差分の基準用。

    config MUSE_HATCH
        bool "Muse's own voice session (chat API)"
        default y
        depends on SPIKE_WITH_CHAT
        help
            SDK の chat 層 (muse_chat_session.cpp) をビルドする。PSRAM 前提。

    config MUSE_HATCH_COMPACT_BUFFERS
        bool "Smaller session buffers"
        depends on MUSE_HATCH
        default n

    config MUSE_REALTIME_VOICE
        bool "Live voice calls (not part of B-min)"
        default n

    config MUSE_REALTIME_VOICE_APP_ID
        string "App ID the voice session connects as"
        default "hatch-web"
        depends on MUSE_REALTIME_VOICE

    config MUSE_LATEST_REPLY
        bool "Keep the latest reply for rereading (not part of B-min)"
        default n

    config MUSE_BOARD_SENSECAP_WATCHER
        bool
        default n

    config MUSE_APP_VIEW
        bool
        default n

    config MUSE_WASM_APPS
        bool
        default n

    config MUSE_WAKEWORD_ENABLE
        bool
        default n

endmenu
```

## tools/muse-gadget/spike/sdkconfig.defaults
```kconfig
# T49 spike の最小設定。SAS-Watch 本体に近い形 (32MB flash / 8MB octal PSRAM /
# PERF 最適化 / HZ=1000) にしておき、サイズ比較を意味のあるものにする。
CONFIG_IDF_TARGET="esp32s3"
CONFIG_ESPTOOLPY_FLASHSIZE_32MB=y
CONFIG_ESPTOOLPY_FLASHSIZE="32MB"
CONFIG_SPIRAM=y
CONFIG_SPIRAM_MODE_OCT=y
CONFIG_SPIRAM_SPEED_80M=y
CONFIG_SPIRAM_USE_MALLOC=y
CONFIG_SPIRAM_ALLOW_STACK_EXTERNAL_MEMORY=y
CONFIG_SPIRAM_ALLOW_BSS_SEG_EXTERNAL_MEMORY=y
CONFIG_FREERTOS_HZ=1000
CONFIG_COMPILER_OPTIMIZATION_PERF=y
CONFIG_COMPILER_CXX_EXCEPTIONS=n
CONFIG_COMPILER_CXX_RTTI=n
CONFIG_LOG_DEFAULT_LEVEL_INFO=y
```
